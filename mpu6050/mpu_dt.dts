/dts-v1/;
/plugin/;

/ {
    compatible = "brcm,bcm2835";
	fragment@0 {
		target = <&i2c1>;
		__overlay__ {
			status = "okay";
			#address-cells = <0x01>;
			#size-cells = <0x0>;
			mpu6050: mpu6050@68 {
				compatible = "mpu6050", "icm20689";
				reg = <0x68>;
			};
		};
	};
};
