/dts-v1/;
/plugin/;
/ {
	compatible = "brcm,bcm2835";
	fragment@0 {
		target-path = "/";
		__overlay__ {
			lcd_button1 {
				compatible = "lcd_button";
				status = "okay";
				id = <1>;
				lcd-button-gpio = <&gpio 18 17>;
                bias-pull-up;  
			};
            lcd_button2 {
				compatible = "lcd_button";
				status = "okay";
				id = <2>;
				lcd-button-gpio = <&gpio 23 17>;
                bias-pull-up;  
			};
            lcd_button3 {
				compatible = "lcd_button";
				status = "okay";
				id = <3>;
				lcd-button-gpio = <&gpio 24 17>;
                bias-pull-up; 
			};
		};
	};
};
